## src/modules/depth_estimator/Kconfig
```kconfig
menuconfig MODULES_DEPTH_ESTIMATOR
	bool "depth_estimator"
	default n
	---help---
		Enable support for depth_estimator
```

## src/modules/hydro_att_control/Kconfig
```kconfig
menuconfig MODULES_HYDRO_ATT_CONTROL
	bool "hydro_att_control"
	default n
	---help---
		Enable support for hydro_att_control
```

## src/modules/hydro_control_allocator/Kconfig
```kconfig
menuconfig MODULES_HYDRO_CONTROL_ALLOCATOR
	bool "hydro_control_allocator"
	default n
	---help---
		Enable support for hydro_control_allocator
```

## src/modules/hydro_pos_control/Kconfig
```kconfig
menuconfig MODULES_HYDRO_POS_CONTROL
	bool "hydro_pos_control"
	default n
	---help---
		Enable support for hydro_pos_control
```

## src/modules/hydro_rate_control/Kconfig
```kconfig
menuconfig MODULES_HYDRO_RATE_CONTROL
	bool "hydro_rate_control"
	default n
	---help---
		Enable support for hydro_rate_control
```

## src/modules/mavdebug/Kconfig
```kconfig
menuconfig MODULES_MAVDEBUG
	bool "mavdebug"
	default n
	---help---
		Enable support for mavdebug
```

## src/modules/mode_control/Kconfig
```kconfig
menuconfig MODULES_MODE_CONTROL
	bool "mode_control"
	default n
	---help---
		Enable support for mode_control
```
